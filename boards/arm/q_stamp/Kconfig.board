## boards/arm/q_stamp/Kconfig.board
```kconfig
# Copyright (c) 2024 The ZMK Contributors
# SPDX-License-Identifier: MIT

config BOARD_Q_STAMP
	bool "Q Stamp"
	depends on SOC_NRF52840_QIAA
```

## boards/arm/q_stamp/Kconfig.defconfig
```kconfig
# Copyright (c) 2024 Brandon Beltran
# SPDX-License-Identifier: MIT

if BOARD_Q_STAMP

config ZMK_KEYBOARD_NAME
	default "Q-Stamp"

if USB_DEVICE_STACK

config USB_NRFX
	default y

endif # USB_DEVICE_STACK

config BT_CTLR
	default BT

endif # BOARD_Q_STAMP
```
